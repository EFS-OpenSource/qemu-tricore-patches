## hw/tricore/Kconfig
```kconfig
config TRICORE_TESTBOARD
    bool

config TRIBOARD
    bool
    select TC27X_SOC

config TC27X_SOC
    bool
    select TRICORE_ASCLIN
    select TRICORE_IRBUS
    select TRICORE_SCU
    select TRICORE_STM
    select TRICORE_VIRT

config TRICORE_SCU
    bool

config TRICORE_VIRT
    bool
```
